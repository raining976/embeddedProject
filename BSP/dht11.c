#include "dht11.h"


/****************************************************************************************
函数名称  ： DHT11_IO_Init
函数功能  ： DHT11传感器GPIO端口初始化
函数形参  ： 无
函数返回值： 无
函数描述  ： DHT11的SCK/DATA --- PB6 --- 通用开漏输出
*******************************************************************************************/
void DHT11_IO_Init(void)
{
	GPIO_InitTypeDef GPIO_InitStruct;
	
	//时钟使能
	RCC_APB2PeriphClockCmd(RCC_APB2Periph_GPIOB,ENABLE); //端口B时钟使能
	//初始化GPIO口
	GPIO_InitStruct.GPIO_Mode = GPIO_Mode_Out_OD;        //开漏模式
	GPIO_InitStruct.GPIO_Pin = GPIO_Pin_6;               //选中管脚6
	GPIO_InitStruct.GPIO_Speed = GPIO_Speed_50MHz;       //输出速度50MHz
	GPIO_Init(GPIOB,&GPIO_InitStruct);                   //初始化B端口
	
	DHT11_BUS_H;                                         //空闲状态为高电平
}
/*****************************************************************************************
函数名称  ： DHT11_Strat_Ack
函数功能  ： DHT11传感器MCU发送起始信号并等待DHT11发送响应信号
函数形参  ： 无
函数返回值： 0：有响应；1：未检测到响应
函数描述  ：
	起始信号--MCU拉低数据线至少持续18ms，然后拉高数据线20～40us
	切换成输入模式或者输出高电平均可，总线由上拉电阻拉高，等待DHT11传输数据
	响应信号--等待DHT11拉低数据线且拉低时间为80us
	准备发送--等待DHT11拉高数据线且拉高时间为80us
******************************************************************************************/
u8 DHT11_Strat_Ack(void)
{
	u16 time_err = 0;
	
	DHT11_BUS_L;                                        //拉低数据线
	fml_delay_ms(20);                                   //延时至少18ms，产生起始信号
	DHT11_BUS_H;                                        //拉高数据线20~40us
	fml_delay_us(30);                                   //拉高数据线20～40us
/* 转换成输入模式，等待接收DHT11的响应信号和数据信号 */
	while(DHT11_BUS_IN)            //等待DHT11主动拉低总线 -- 响应信号
	{
		time_err++;
		if(time_err >= 10000)	
			return 1;
	}

	time_err = 0;
	while( !DHT11_BUS_IN )  	//等待DHT11主动拉高总线 -- 准备发送数据
	{
		time_err++;
		if(time_err >= 10000)
			return 1;
	}
	return 0;
}
/*****************************************************************************************
函数名称  ： DHT11_Read_Bit
函数功能  ： 从DHT11读取发送的一个位
函数形参  ： 无
函数返回值： 低电平：数据0；高电平：数据1
函数描述  ：
	等待DHT11拉低总线持续50us
	等待DHT11拉高总线，计算高电平维持时间
	高电平时间30us后仍然是高电平----发送的是数据1
	高电平时间30us后变成是低电平----发送的是数据0
******************************************************************************************/
u8 DHT11_Read_Bit(void)
{
	while(DHT11_BUS_IN)
	{
		fml_delay_us(1);
	}
	while(!DHT11_BUS_IN)
	{
		fml_delay_us(1);
	}
	fml_delay_us(40);
	return DHT11_BUS_IN;
}
/*****************************************************************************************
函数名称  ：DHT11_Read_Byte
函数功能  ：从DHT11读取发送的一个字节
函数形参  ：无
函数返回值：读到的字节
函数描述  ：
	读取8次、高位在前
******************************************************************************************/
u8 DHT11_Read_Byte(void)
{
	u8 i = 0;
	u8 data = 0;
	
	for(i = 0;i < 8;++i)
	{
		data |= DHT11_Read_Bit() << (7 - i);
	}
	return data;
}

/******************************************************************************************
函数名称  ： DHT11_Read_Data
函数功能  ： DHT11管脚初始化、发送起始信号并检测应答
函数形参  ： u8 *Temperature：温度值, u8 *Humidity：湿度值
函数返回值： 无
函数描述  ：
******************************************************************************************/
void DHT11_Read_Data(u8 *Temperature,u8 *Humidity)
{
	u8 i = 0;
	u8 buff[5] = {0};
	
	if(!DHT11_Strat_Ack())
	{	
		for(i = 0;i < 5;++i)
		{
			buff[i] = DHT11_Read_Byte();
		}
		if(buff[4] == buff[0] + buff[1] + buff[2] + buff[3])
		{
			*Temperature = buff[2];
			*Humidity =  buff[0];
		}
	}
}







